## drivers/oem_debug/Kconfig
```kconfig
#add by jiachenghui for support oem trace,2015/05/09

config OEM_TRACE_SUPORT
	depends on OEM_DEBUG_SUPORT
	bool "OEM debug function, enable it will register the device, which under /dev/otracer."
	default n

config OEM_FORCE_DUMP
	depends on OEM_DEBUG_SUPORT
	bool "OEM force dump function, it will enable goto the force dump"
	default n
```
